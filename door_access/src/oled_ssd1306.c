#include <ctype.h>
#include <string.h>
#include "driver/i2c.h"
#include "esp_log.h"
#include "oled_ssd1306.h"

#define TAG        "oled"
#define OLED_PORT  I2C_NUM_0
#define OLED_SDA   21
#define OLED_SCL   22
#define OLED_ADDR  0x3C          /* some modules use 0x3D */
#define OLED_W     128
#define OLED_PAGES 8

/* Control byte that starts every I2C message to the SSD1306:
 *   0x00 = the bytes after me are COMMANDS
 *   0x40 = the bytes after me are DISPLAY DATA
 *   0x80 = one command follows, then another control byte (Co=1)   */
#define CTRL_CMD_STREAM 0x00
#define CTRL_DATA       0x40
#define CTRL_CMD_ONE    0x80

static uint8_t fb[OLED_PAGES * OLED_W];   /* page p = text row p */

/* 5x7 font, ASCII 0x20..0x5F (space, digits, punctuation, A-Z).
 * One glyph = 5 columns. In each byte bit0 = top pixel, bit7 = bottom,
 * which is exactly how the SSD1306 expects its page data.            */
static const uint8_t font5x7[64][5] = {
    {0x00,0x00,0x00,0x00,0x00}, {0x00,0x00,0x5F,0x00,0x00}, {0x00,0x07,0x00,0x07,0x00}, {0x14,0x7F,0x14,0x7F,0x14},
    {0x24,0x2A,0x7F,0x2A,0x12}, {0x23,0x13,0x08,0x64,0x62}, {0x36,0x49,0x55,0x22,0x50}, {0x00,0x05,0x03,0x00,0x00},
    {0x00,0x1C,0x22,0x41,0x00}, {0x00,0x41,0x22,0x1C,0x00}, {0x14,0x08,0x3E,0x08,0x14}, {0x08,0x08,0x3E,0x08,0x08},
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    {0x02,0x04,0x08,0x10,0x20}, {0x00,0x41,0x41,0x7F,0x00}, {0x04,0x02,0x01,0x02,0x04}, {0x40,0x40,0x40,0x40,0x40},
};

static esp_err_t oled_cmd(uint8_t c)
{
    i2c_cmd_handle_t h = i2c_cmd_link_create();
    i2c_master_start(h);
    i2c_master_write_byte(h, (OLED_ADDR << 1) | I2C_MASTER_WRITE, true);
    i2c_master_write_byte(h, CTRL_CMD_STREAM, true);
    i2c_master_write_byte(h, c, true);
    i2c_master_stop(h);
    esp_err_t e = i2c_master_cmd_begin(OLED_PORT, h, pdMS_TO_TICKS(100));
    i2c_cmd_link_delete(h);
    return e;
}

esp_err_t oled_init(void)
{
    i2c_config_t cfg = {
        .mode = I2C_MODE_MASTER,
        .sda_io_num = OLED_SDA,
        .scl_io_num = OLED_SCL,
        .sda_pullup_en = GPIO_PULLUP_ENABLE,
        .scl_pullup_en = GPIO_PULLUP_ENABLE,
        .master.clk_speed = 400000,
    };
    ESP_ERROR_CHECK(i2c_param_config(OLED_PORT, &cfg));
    ESP_ERROR_CHECK(i2c_driver_install(OLED_PORT, I2C_MODE_MASTER, 0, 0, 0));

    static const uint8_t init_seq[] = {
        0xAE,             /* display OFF while configuring            */
        0xD5, 0x80,       /* clock divide / oscillator                */
        0xA8, 0x3F,       /* multiplex = 64 rows                      */
        0xD3, 0x00,       /* display offset = 0                       */
        0x40,             /* start line = 0                           */
        0x8D, 0x14,       /* charge pump ON (needed with 3.3 V)       */
        0x20, 0x02,       /* PAGE addressing mode                     */
        0xA1,             /* segment remap  (flip X if text mirrored) */
        0xC8,             /* COM scan reversed (flip Y if upside down)*/
        0xDA, 0x12,       /* COM pins config for 128x64               */
        0x81, 0xCF,       /* contrast                                 */
        0xD9, 0xF1,       /* pre-charge                               */
        0xDB, 0x40,       /* VCOMH level                              */
        0xA4,             /* show RAM content                         */
        0xA6,             /* normal (not inverted)                    */
        0xAF,             /* display ON                               */
    };
    for (size_t i = 0; i < sizeof init_seq; i++) {
        esp_err_t e = oled_cmd(init_seq[i]);
        if (e != ESP_OK) {
            ESP_LOGE(TAG, "no ACK from OLED at 0x%02X (check SDA/SCL/power/address)", OLED_ADDR);
            return e;
        }
    }
    oled_clear();
    return oled_flush();
}

void oled_clear(void)              { memset(fb, 0, sizeof fb); }
void oled_clear_row(uint8_t row)   { if (row < OLED_ROWS) memset(&fb[row * OLED_W], 0, OLED_W); }

void oled_text(uint8_t col, uint8_t row, const char *s)
{
    if (row >= OLED_ROWS || s == NULL) return;
    int x = col * 6;
    for (; *s && x + 6 <= OLED_W; s++, x += 6) {
        int c = toupper((unsigned char)*s);
        if (c < 0x20 || c > 0x5F) c = '?';
        memcpy(&fb[row * OLED_W + x], font5x7[c - 0x20], 5);
        fb[row * OLED_W + x + 5] = 0x00;      /* 1 blank column between chars */
    }
}

/* One I2C transaction per page: "set page + column" commands and then 128 data bytes. */
esp_err_t oled_flush(void)
{
    for (uint8_t p = 0; p < OLED_PAGES; p++) {
        i2c_cmd_handle_t h = i2c_cmd_link_create();
        i2c_master_start(h);
        i2c_master_write_byte(h, (OLED_ADDR << 1) | I2C_MASTER_WRITE, true);
        i2c_master_write_byte(h, CTRL_CMD_ONE, true); i2c_master_write_byte(h, 0xB0 | p, true); /* page      */
        i2c_master_write_byte(h, CTRL_CMD_ONE, true); i2c_master_write_byte(h, 0x00, true);     /* col low   */
        i2c_master_write_byte(h, CTRL_CMD_ONE, true); i2c_master_write_byte(h, 0x10, true);     /* col high  */
        i2c_master_write_byte(h, CTRL_DATA, true);
        i2c_master_write(h, &fb[p * OLED_W], OLED_W, true);
        i2c_master_stop(h);
        esp_err_t e = i2c_master_cmd_begin(OLED_PORT, h, pdMS_TO_TICKS(100));
        i2c_cmd_link_delete(h);
        if (e != ESP_OK) return e;
    }
    return ESP_OK;
}
